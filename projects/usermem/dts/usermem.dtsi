/ {
	amba_pl: amba_pl {
		#address-cells = <1>;
		#size-cells = <1>;
		compatible = "simple-bus";
		ranges ;
		usermem@43c00000 {
			compatible = "usermem";
			reg = <0x44000000 0x400000>;
		};
	};
};
